## CMakeLists.txt
```
cmake_minimum_required(VERSION 3.20.0)
find_package(Zephyr REQUIRED HINTS $ENV{ZEPHYR_BASE})
project(skywatch_controller)

# Per-lib source listing. Layout convention: every lib lives at
# src/<lib>/src/ (code + private headers)
# src/<lib>/ref/ (self-reference description.md)
# See resources/organisation/file_layout.md for the full spec.

target_sources(app PRIVATE
    src/main/src/main.c
    src/shell/src/shell.c
    src/usb_device/src/usb_device.c
    src/usb_serial/src/usb_serial.c
    src/usb_handler/src/usb_handler.c
    src/json/src/json_parser.c
    src/ble/src/ble_central.c
    src/bridge/src/bridge.c
    src/aircraft_db/src/aircraft_db.c
    src/db_publisher/src/db_publisher.c
    src/kalman/src/kalman.c
    src/collision/src/collision.c
    src/missile/src/missile.c
)

# Each lib's src/ is also its public include dir — keeps the module boundary
# narrow: headers that are not in a sibling lib's src/ are not reachable.
target_include_directories(app PRIVATE
    ${CMAKE_CURRENT_SOURCE_DIR}/src/common/src
    ${CMAKE_CURRENT_SOURCE_DIR}/src/shell/src
    ${CMAKE_CURRENT_SOURCE_DIR}/src/usb_device/src
    ${CMAKE_CURRENT_SOURCE_DIR}/src/usb_serial/src
    ${CMAKE_CURRENT_SOURCE_DIR}/src/usb_handler/src
    ${CMAKE_CURRENT_SOURCE_DIR}/src/json/src
    ${CMAKE_CURRENT_SOURCE_DIR}/src/ble/src
    ${CMAKE_CURRENT_SOURCE_DIR}/src/bridge/src
    ${CMAKE_CURRENT_SOURCE_DIR}/src/aircraft_db/src
    ${CMAKE_CURRENT_SOURCE_DIR}/src/db_publisher/src
    ${CMAKE_CURRENT_SOURCE_DIR}/src/kalman/src
    ${CMAKE_CURRENT_SOURCE_DIR}/src/collision/src
    ${CMAKE_CURRENT_SOURCE_DIR}/src/missile/src
)
```

## prj.conf
```kconfig
# SkyWatch controller — Zephyr Kconfig for the production firmware.
# Covers all phases: dual CDC ACM (shell + data), BLE central + GATT
# client, JSON parser, double-precision FPU + sharing, GPIO for the
# heartbeat LED, MPU stack-overflow guard, and a generous-but-not-
# wasteful 8 KB heap / 4 KB main+workqueue stack budget.

# GPIO for the heartbeat LED (green = up, off-during-init = red). Same pattern
# as the mobile sim node (resources/importedcode/Will_BLE/mobile/codein.c).
CONFIG_GPIO=y

# Stack-overflow guard. Earlier the 2048 B bridge thread silently
# overflowed on the first heavy BLE-frame burst (Kalman + JSON locals).
# With this flag on (uses the Cortex-M MPU), an overflow now hits an
# oops + reboots cleanly so the symptom is visible in logs rather than
# a wedged heartbeat LED. Stack sizes bumped to 4 KB independently —
# see bridge.c / usb_handler.c.
CONFIG_HW_STACK_PROTECTION=y

# Shell — routed through USB CDC ACM0 (board-default shell-uart)
CONFIG_SHELL=y
CONFIG_SHELL_BACKEND_SERIAL=y
CONFIG_SHELL_LOG_BACKEND=y
CONFIG_LOG_PRINTK=y
CONFIG_SHELL_STACK_SIZE=4096
CONFIG_SHELL_VT100_COLORS=n
# Bigger shell-uart RX ring so collision + db_publisher log spam doesn't
# trigger 'RX ring buffer full' on ACM0 during heavy ticks.
CONFIG_SHELL_BACKEND_SERIAL_RX_RING_BUFFER_SIZE=512

# USB CDC ACM — custom init in usb_device.c registers cdc_acm_0 (shell/ttyACM0)
# then cdc_acm_1 (data/ttyACM1, from app.overlay).
CONFIG_USBD_CDC_ACM_CLASS=y
CONFIG_CDC_ACM_SERIAL_INITIALIZE_AT_BOOT=n

# UART line control — needed for DTR detection on the data CDC ACM port
CONFIG_UART_LINE_CTRL=y

# UART interrupt-driven Rx + ring buffer for data-port frame reassembly
CONFIG_UART_INTERRUPT_DRIVEN=y
CONFIG_RING_BUFFER=y

# JSON parser + double-precision FP for lat/lon/ts
CONFIG_JSON_LIBRARY=y
CONFIG_JSON_LIBRARY_FP_SUPPORT=y
CONFIG_FPU=y
CONFIG_FPU_SHARING=y
CONFIG_CBPRINTF_FP_SUPPORT=y

# Bluetooth — central role, GATT client, scanning, larger MTU/buffers for the
# 38-byte ble_aircraft_frame (default ATT MTU=23 would not fit).
CONFIG_BT=y
CONFIG_BT_CENTRAL=y
CONFIG_BT_GATT_CLIENT=y
CONFIG_BT_OBSERVER=y
CONFIG_BT_SCAN_WITH_IDENTITY=y
CONFIG_BT_L2CAP_TX_MTU=247
CONFIG_BT_BUF_ACL_RX_SIZE=251
CONFIG_BT_BUF_ACL_TX_SIZE=251
CONFIG_BT_DEVICE_NAME="skywatch-controller"

# Logging — shell log backend handles output
CONFIG_LOG=y
CONFIG_LOG_DEFAULT_LEVEL=3
CONFIG_LOG_BUFFER_SIZE=4096

# Memory — modest defaults; later phases will bump heap
CONFIG_HEAP_MEM_POOL_SIZE=8192
CONFIG_MAIN_STACK_SIZE=4096
# 4096 B (was 2048) — collision.c work_handler runs on the system queue
# with a 32-aircraft snap buffer + per-pair math + multiple JSON snprintfs,
# and drives the diversion-picker + crash-frame BLE sends. Bumped for
# headroom; HW_STACK_PROTECTION catches future regressions.
CONFIG_SYSTEM_WORKQUEUE_STACK_SIZE=4096
```

## app.overlay
```dts
/* Device tree overlay: add CDC ACM UART to the nRF52840 USB device */
&zephyr_udc0 {
	cdc_acm_uart0: cdc_acm_uart0 {
		compatible = "zephyr,cdc-acm-uart";
	};
};
```

## src/shell.c
```c
/*
 * SkyWatch controller shell — Phase 2.1 skeleton.
 *
 * Stage:    2.1
 * Purpose:  Single `skywatch` subcommand tree with one `ping` leaf so we can
 *           prove the shell is alive over ACM0 ("skywatch ping" -> "pong").
 *           Later phases hang db/kalman/ble/collision subcommands off the
 *           same root (Stages 4.3, 7.3, 8.x).
 */

#include <string.h>

#include <zephyr/kernel.h>
#include <zephyr/shell/shell.h>

#include "usb_handler.h"
#include "json_parser.h"
#include "aircraft_t.h"

static int cmd_skywatch_ping(const struct shell *sh, size_t argc, char **argv)
{
	ARG_UNUSED(argc);
	ARG_UNUSED(argv);
	shell_print(sh, "pong");
	return 0;
}

static int cmd_skywatch_usb_stats(const struct shell *sh, size_t argc, char **argv)
{
	ARG_UNUSED(argc);
	ARG_UNUSED(argv);
	struct usb_handler_stats s;
	usb_handler_get_stats(&s);
	shell_print(sh,
		    "bytes_rx=%u frames_rx=%u ringbuf_drops=%u line_overruns=%u parse_errors=%u",
		    s.bytes_rx, s.frames_rx, s.ringbuf_drops, s.line_overruns,
		    s.parse_errors);
	return 0;
}

/* Two canned ADS-B frames used by `skywatch test_json` —
 *   - "full"  exercises every field including the optionals,
 *   - "minimal" omits alt/vel/hdg to exercise the optional-absent path. */
static const char SAMPLE_FULL[] =
	"{\"type\":\"aircraft\",\"icao\":\"a1b2c3\","
	"\"lat\":-27.4975,\"lon\":153.0137,"
	"\"alt\":3500,\"vel\":450.0,\"hdg\":90.0,"
	"\"ts\":1715683200.0,\"source\":\"ADS_B\"}";

static const char SAMPLE_MINIMAL[] =
	"{\"type\":\"aircraft\",\"icao\":\"d4e5f6\","
	"\"lat\":-27.5,\"lon\":153.0,"
	"\"ts\":1715683201.0,\"source\":\"ADS_B\"}";

static void print_parsed(const struct shell *sh, const struct aircraft_t *ac)
{
	shell_print(sh, "  icao        = %s",   ac->icao);
	shell_print(sh, "  source      = %s",   aircraft_source_str(ac->source));
	shell_print(sh, "  lat         = %.6f", ac->lat);
	shell_print(sh, "  lon         = %.6f", ac->lon);
	shell_print(sh, "  ts          = %.3f", ac->ts);
	shell_print(sh, "  valid_mask  = 0x%x", ac->valid_mask);
	if (ac->valid_mask & AIRCRAFT_VALID_ALT) {
		shell_print(sh, "  alt_ft      = %d", ac->alt_ft);
	} else {
		shell_print(sh, "  alt_ft      = (absent)");
	}
	if (ac->valid_mask & AIRCRAFT_VALID_VEL) {
		shell_print(sh, "  vel_kt      = %.1f", ac->vel_kt);
	} else {
		shell_print(sh, "  vel_kt      = (absent)");
	}
	if (ac->valid_mask & AIRCRAFT_VALID_HDG) {
		shell_print(sh, "  hdg_deg     = %.1f", ac->hdg_deg);
	} else {
		shell_print(sh, "  hdg_deg     = (absent)");
	}
}

static int parse_and_print(const struct shell *sh, const char *src, const char *label)
{
	char buf[256];
	size_t n = strnlen(src, sizeof(buf) - 1);
	memcpy(buf, src, n);
	buf[n] = '\0';

	shell_print(sh, "--- %s ---", label);
	shell_print(sh, "JSON: %s", src);

	struct aircraft_t ac;
	int err = json_parse_aircraft(buf, n, &ac);
	if (err < 0) {
		shell_error(sh, "parse failed: %d", err);
		return err;
	}
	print_parsed(sh, &ac);
	return 0;
}

static int cmd_skywatch_test_json(const struct shell *sh, size_t argc, char **argv)
{
	ARG_UNUSED(argc);
	ARG_UNUSED(argv);
	int rc1 = parse_and_print(sh, SAMPLE_FULL,    "full sample");
	int rc2 = parse_and_print(sh, SAMPLE_MINIMAL, "minimal sample (alt/vel/hdg absent)");
	return (rc1 < 0) ? rc1 : rc2;
}


SHELL_STATIC_SUBCMD_SET_CREATE(sub_usb,
	SHELL_CMD(stats, NULL, "Print ACM1 Rx counters.", cmd_skywatch_usb_stats),
	SHELL_SUBCMD_SET_END
);

SHELL_STATIC_SUBCMD_SET_CREATE(sub_skywatch,
	SHELL_CMD(ping, NULL, "Reply with 'pong' (shell liveness check).",
		  cmd_skywatch_ping),
	SHELL_CMD(usb, &sub_usb, "USB CDC ACM1 Rx subcommands.", NULL),
	SHELL_CMD(test_json, NULL,
		  "Parse hardcoded ADS-B JSON samples and print each struct field.",
		  cmd_skywatch_test_json),
	SHELL_SUBCMD_SET_END
);

SHELL_CMD_REGISTER(skywatch, &sub_skywatch,
		   "SkyWatch controller commands.", NULL);
```
