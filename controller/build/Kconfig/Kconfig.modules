## controller/build/Kconfig/Kconfig.modules
```kconfig
menu "firmware (/home/blaise/csse4011/firmware)"
osource "/home/blaise/csse4011/firmware/Kconfig"
config ZEPHYR_FIRMWARE_MODULE
	bool
	default y
endmenu
menu "csse4011-sdk (/home/blaise/csse4011/csse4011-sdk)"
osource "/home/blaise/csse4011/csse4011-sdk/Kconfig"
config ZEPHYR_CSSE4011_SDK_MODULE
	bool
	default y
endmenu
menu "cmsis (/home/blaise/csse4011/modules/hal/cmsis)"
osource "$(ZEPHYR_CMSIS_KCONFIG)"
config ZEPHYR_CMSIS_MODULE
	bool
	default y
endmenu
menu "cmsis-dsp (/home/blaise/csse4011/modules/lib/cmsis-dsp)"
osource "$(ZEPHYR_CMSIS_DSP_KCONFIG)"
config ZEPHYR_CMSIS_DSP_MODULE
	bool
	default y
endmenu
menu "cmsis-nn (/home/blaise/csse4011/modules/lib/cmsis-nn)"
osource "$(ZEPHYR_CMSIS_NN_KCONFIG)"
config ZEPHYR_CMSIS_NN_MODULE
	bool
	default y
endmenu
menu "cmsis_6 (/home/blaise/csse4011/modules/hal/cmsis_6)"
osource "$(ZEPHYR_CMSIS_6_KCONFIG)"
config ZEPHYR_CMSIS_6_MODULE
	bool
	default y
endmenu
menu "fatfs (/home/blaise/csse4011/modules/fs/fatfs)"
osource "$(ZEPHYR_FATFS_KCONFIG)"
config ZEPHYR_FATFS_MODULE
	bool
	default y
endmenu
menu "hal_nordic (/home/blaise/csse4011/modules/hal/nordic)"
osource "$(ZEPHYR_HAL_NORDIC_KCONFIG)"
config ZEPHYR_HAL_NORDIC_MODULE
	bool
	default y

config ZEPHYR_HAL_NORDIC_MODULE_BLOBS
	bool
endmenu
menu "hal_rpi_pico (/home/blaise/csse4011/modules/hal/rpi_pico)"
osource "$(ZEPHYR_HAL_RPI_PICO_KCONFIG)"
config ZEPHYR_HAL_RPI_PICO_MODULE
	bool
	default y
endmenu
menu "hal_st (/home/blaise/csse4011/modules/hal/st)"
osource "$(ZEPHYR_HAL_ST_KCONFIG)"
config ZEPHYR_HAL_ST_MODULE
	bool
	default y
endmenu
config ZEPHYR_HAL_STM32_MODULE
	bool
	default y

config ZEPHYR_HAL_STM32_MODULE_BLOBS
	bool
menu "hal_tdk (/home/blaise/csse4011/modules/hal/tdk)"
osource "$(ZEPHYR_HAL_TDK_KCONFIG)"
config ZEPHYR_HAL_TDK_MODULE
	bool
	default y
endmenu
config ZEPHYR_HAL_WURTHELEKTRONIK_MODULE
	bool
	default y
menu "hostap (/home/blaise/csse4011/modules/lib/hostap)"
osource "$(ZEPHYR_HOSTAP_KCONFIG)"
config ZEPHYR_HOSTAP_MODULE
	bool
	default y
endmenu
menu "liblc3 (/home/blaise/csse4011/modules/lib/liblc3)"
osource "$(ZEPHYR_LIBLC3_KCONFIG)"
config ZEPHYR_LIBLC3_MODULE
	bool
	default y
endmenu
config ZEPHYR_LIBMETAL_MODULE
	bool
	default y
menu "littlefs (/home/blaise/csse4011/modules/fs/littlefs)"
osource "$(ZEPHYR_LITTLEFS_KCONFIG)"
config ZEPHYR_LITTLEFS_MODULE
	bool
	default y
endmenu
menu "loramac-node (/home/blaise/csse4011/modules/lib/loramac-node)"
osource "$(ZEPHYR_LORAMAC_NODE_KCONFIG)"
config ZEPHYR_LORAMAC_NODE_MODULE
	bool
	default y
endmenu
menu "lvgl (/home/blaise/csse4011/modules/lib/gui/lvgl)"
osource "/home/blaise/csse4011/modules/lib/gui/lvgl/zephyr/Kconfig"
config ZEPHYR_LVGL_MODULE
	bool
	default y
endmenu
menu "mbedtls (/home/blaise/csse4011/modules/crypto/mbedtls)"
osource "$(ZEPHYR_MBEDTLS_KCONFIG)"
config ZEPHYR_MBEDTLS_MODULE
	bool
	default y
endmenu
config ZEPHYR_MIPI_SYS_T_MODULE
	bool
	default y
menu "nanopb (/home/blaise/csse4011/modules/lib/nanopb)"
osource "$(ZEPHYR_NANOPB_KCONFIG)"
config ZEPHYR_NANOPB_MODULE
	bool
	default y
endmenu
menu "nrf_wifi (/home/blaise/csse4011/modules/lib/nrf_wifi)"
osource "$(ZEPHYR_NRF_WIFI_KCONFIG)"
config ZEPHYR_NRF_WIFI_MODULE
	bool
	default y

config ZEPHYR_NRF_WIFI_MODULE_BLOBS
	bool
endmenu
config ZEPHYR_OPEN_AMP_MODULE
	bool
	default y
menu "percepio (/home/blaise/csse4011/modules/debug/percepio)"
osource "/home/blaise/csse4011/modules/debug/percepio/zephyr/Kconfig"
config ZEPHYR_PERCEPIO_MODULE
	bool
	default y
endmenu
menu "picolibc (/home/blaise/csse4011/modules/lib/picolibc)"
osource "/home/blaise/csse4011/modules/lib/picolibc/zephyr/Kconfig"
config ZEPHYR_PICOLIBC_MODULE
	bool
	default y
endmenu
menu "segger (/home/blaise/csse4011/modules/debug/segger)"
osource "$(ZEPHYR_SEGGER_KCONFIG)"
config ZEPHYR_SEGGER_MODULE
	bool
	default y
endmenu
menu "uoscore-uedhoc (/home/blaise/csse4011/modules/lib/uoscore-uedhoc)"
osource "$(ZEPHYR_UOSCORE_UEDHOC_KCONFIG)"
config ZEPHYR_UOSCORE_UEDHOC_MODULE
	bool
	default y
endmenu
menu "zcbor (/home/blaise/csse4011/modules/lib/zcbor)"
osource "$(ZEPHYR_ZCBOR_KCONFIG)"
config ZEPHYR_ZCBOR_MODULE
	bool
	default y
endmenu
config ZEPHYR_NRF_HW_MODELS_MODULE
	bool
	default y
```

## controller/build/Kconfig/Kconfig.sysbuild.modules
```kconfig
config ZEPHYR_FIRMWARE_MODULE
   bool
   default y
config ZEPHYR_CSSE4011_SDK_MODULE
   bool
   default y
config ZEPHYR_CMSIS_MODULE
   bool
   default y
config ZEPHYR_CMSIS_DSP_MODULE
   bool
   default y
config ZEPHYR_CMSIS_NN_MODULE
   bool
   default y
config ZEPHYR_CMSIS_6_MODULE
   bool
   default y
config ZEPHYR_FATFS_MODULE
   bool
   default y
config ZEPHYR_HAL_NORDIC_MODULE
   bool
   default y
config ZEPHYR_HAL_RPI_PICO_MODULE
   bool
   default y
config ZEPHYR_HAL_ST_MODULE
   bool
   default y
config ZEPHYR_HAL_STM32_MODULE
   bool
   default y
config ZEPHYR_HAL_TDK_MODULE
   bool
   default y
config ZEPHYR_HAL_WURTHELEKTRONIK_MODULE
   bool
   default y
config ZEPHYR_HOSTAP_MODULE
   bool
   default y
config ZEPHYR_LIBLC3_MODULE
   bool
   default y
config ZEPHYR_LIBMETAL_MODULE
   bool
   default y
config ZEPHYR_LITTLEFS_MODULE
   bool
   default y
config ZEPHYR_LORAMAC_NODE_MODULE
   bool
   default y
config ZEPHYR_LVGL_MODULE
   bool
   default y
config ZEPHYR_MBEDTLS_MODULE
   bool
   default y
config ZEPHYR_MIPI_SYS_T_MODULE
   bool
   default y
config ZEPHYR_NANOPB_MODULE
   bool
   default y
config ZEPHYR_NRF_WIFI_MODULE
   bool
   default y
config ZEPHYR_OPEN_AMP_MODULE
   bool
   default y
config ZEPHYR_PERCEPIO_MODULE
   bool
   default y
config ZEPHYR_PICOLIBC_MODULE
   bool
   default y
config ZEPHYR_SEGGER_MODULE
   bool
   default y
config ZEPHYR_UOSCORE_UEDHOC_MODULE
   bool
   default y
config ZEPHYR_ZCBOR_MODULE
   bool
   default y
config ZEPHYR_NRF_HW_MODELS_MODULE
   bool
   default y
```

## controller/build/Kconfig/arch/Kconfig
```kconfig
# Load Zephyr Arch Kconfig descriptions.
osource "/home/blaise/csse4011/zephyr/arch/rx/Kconfig"
osource "/home/blaise/csse4011/zephyr/arch/x86/Kconfig"
osource "/home/blaise/csse4011/zephyr/arch/xtensa/Kconfig"
osource "/home/blaise/csse4011/zephyr/arch/sparc/Kconfig"
osource "/home/blaise/csse4011/zephyr/arch/riscv/Kconfig"
osource "/home/blaise/csse4011/zephyr/arch/posix/Kconfig"
osource "/home/blaise/csse4011/zephyr/arch/mips/Kconfig"
osource "/home/blaise/csse4011/zephyr/arch/arm64/Kconfig"
osource "/home/blaise/csse4011/zephyr/arch/arm/Kconfig"
osource "/home/blaise/csse4011/zephyr/arch/arc/Kconfig"
```

## controller/build/Kconfig/boards/Kconfig.defconfig
```kconfig
# Load Zephyr board defconfig descriptions.
osource "/home/blaise/csse4011/zephyr/boards/seeed/xiao_ble/Kconfig.defconfig"
```

## controller/build/Kconfig/boards/Kconfig.sysbuild
```kconfig
# Load Sysbuild board Kconfig descriptions.
osource "/home/blaise/csse4011/zephyr/boards/seeed/xiao_ble/Kconfig.sysbuild"
```

## controller/build/Kconfig/boards/Kconfig.xiao_ble
```kconfig
# Load board Kconfig descriptions.
osource "/home/blaise/csse4011/zephyr/boards/seeed/xiao_ble/Kconfig.xiao_ble"
```

## controller/build/Kconfig/soc/Kconfig
```kconfig
# Load Zephyr SoC Kconfig descriptions.
osource "/home/blaise/csse4011/zephyr/soc/xlnx/zynqmp/Kconfig"
osource "/home/blaise/csse4011/zephyr/soc/xlnx/zynq7000/Kconfig"
osource "/home/blaise/csse4011/zephyr/soc/xlnx/versalnet/Kconfig"
osource "/home/blaise/csse4011/zephyr/soc/xlnx/versal2/Kconfig"
osource "/home/blaise/csse4011/zephyr/soc/xen/Kconfig"
osource "/home/blaise/csse4011/zephyr/soc/wch/ch32v/Kconfig"
osource "/home/blaise/csse4011/zephyr/soc/ti/simplelink/Kconfig"
osource "/home/blaise/csse4011/zephyr/soc/ti/mspm0/Kconfig"
osource "/home/blaise/csse4011/zephyr/soc/ti/lm3s6965/Kconfig"
osource "/home/blaise/csse4011/zephyr/soc/ti/k3/Kconfig"
osource "/home/blaise/csse4011/zephyr/soc/telink/tlsr/Kconfig"
osource "/home/blaise/csse4011/zephyr/soc/starfive/jh71xx/Kconfig"
osource "/home/blaise/csse4011/zephyr/soc/st/stm32/Kconfig"
osource "/home/blaise/csse4011/zephyr/soc/snps/qemu_arc/Kconfig"
osource "/home/blaise/csse4011/zephyr/soc/snps/nsim/arc_v/Kconfig"
osource "/home/blaise/csse4011/zephyr/soc/snps/nsim/arc_classic/Kconfig"
osource "/home/blaise/csse4011/zephyr/soc/snps/hsdk4xd/Kconfig"
osource "/home/blaise/csse4011/zephyr/soc/snps/hsdk/Kconfig"
osource "/home/blaise/csse4011/zephyr/soc/snps/emsk/Kconfig"
osource "/home/blaise/csse4011/zephyr/soc/snps/emsdp/Kconfig"
osource "/home/blaise/csse4011/zephyr/soc/snps/arc_iot/Kconfig"
osource "/home/blaise/csse4011/zephyr/soc/silabs/Kconfig"
osource "/home/blaise/csse4011/zephyr/soc/sifli/sf32/Kconfig"
osource "/home/blaise/csse4011/zephyr/soc/sifive/sifive_freedom/Kconfig"
osource "/home/blaise/csse4011/zephyr/soc/sensry/Kconfig"
osource "/home/blaise/csse4011/zephyr/soc/rockchip/Kconfig"
osource "/home/blaise/csse4011/zephyr/soc/renode/riscv_virtual/Kconfig"
osource "/home/blaise/csse4011/zephyr/soc/renode/cortex_r8_virtual/Kconfig"
osource "/home/blaise/csse4011/zephyr/soc/renesas/smartbond/Kconfig"
osource "/home/blaise/csse4011/zephyr/soc/renesas/rz/Kconfig"
osource "/home/blaise/csse4011/zephyr/soc/renesas/rx/Kconfig"
osource "/home/blaise/csse4011/zephyr/soc/renesas/rcar/Kconfig"
osource "/home/blaise/csse4011/zephyr/soc/renesas/ra/Kconfig"
osource "/home/blaise/csse4011/zephyr/soc/realtek/ec/Kconfig"
osource "/home/blaise/csse4011/zephyr/soc/raspberrypi/rpi_pico/Kconfig"
osource "/home/blaise/csse4011/zephyr/soc/quicklogic/eos_s3/Kconfig"
osource "/home/blaise/csse4011/zephyr/soc/qemu/virt_riscv/Kconfig"
osource "/home/blaise/csse4011/zephyr/soc/qemu/malta/Kconfig"
osource "/home/blaise/csse4011/zephyr/soc/openisa/rv32m1/Kconfig"
osource "/home/blaise/csse4011/zephyr/soc/openhwgroup/cva6/Kconfig"
osource "/home/blaise/csse4011/zephyr/soc/oct/osd32mp15x/Kconfig"
osource "/home/blaise/csse4011/zephyr/soc/nxp/s32/Kconfig"
osource "/home/blaise/csse4011/zephyr/soc/nxp/rw/Kconfig"
osource "/home/blaise/csse4011/zephyr/soc/nxp/mcx/Kconfig"
osource "/home/blaise/csse4011/zephyr/soc/nxp/lpc/Kconfig"
osource "/home/blaise/csse4011/zephyr/soc/nxp/layerscape/Kconfig"
osource "/home/blaise/csse4011/zephyr/soc/nxp/kinetis/Kconfig"
osource "/home/blaise/csse4011/zephyr/soc/nxp/imxrt/Kconfig"
osource "/home/blaise/csse4011/zephyr/soc/nxp/imx/Kconfig"
osource "/home/blaise/csse4011/zephyr/soc/nuvoton/numicro/Kconfig"
osource "/home/blaise/csse4011/zephyr/soc/nuvoton/numaker/Kconfig"
osource "/home/blaise/csse4011/zephyr/soc/nuvoton/npcx/Kconfig"
osource "/home/blaise/csse4011/zephyr/soc/nuvoton/npcm/Kconfig"
osource "/home/blaise/csse4011/zephyr/soc/nordic/Kconfig"
osource "/home/blaise/csse4011/zephyr/soc/neorv32/Kconfig"
osource "/home/blaise/csse4011/zephyr/soc/native/inf_clock/Kconfig"
osource "/home/blaise/csse4011/zephyr/soc/microchip/sam/Kconfig"
osource "/home/blaise/csse4011/zephyr/soc/microchip/sam/sama7/Kconfig"
osource "/home/blaise/csse4011/zephyr/soc/microchip/sam/sam_d5x_e5x/Kconfig"
osource "/home/blaise/csse4011/zephyr/soc/microchip/pic32c/pic32cz_ca/Kconfig"
osource "/home/blaise/csse4011/zephyr/soc/microchip/pic32c/pic32cx_sg/Kconfig"
osource "/home/blaise/csse4011/zephyr/soc/microchip/pic32c/pic32cm_jh/Kconfig"
osource "/home/blaise/csse4011/zephyr/soc/microchip/miv/Kconfig"
osource "/home/blaise/csse4011/zephyr/soc/microchip/mec/Kconfig"
osource "/home/blaise/csse4011/zephyr/soc/mediatek/mt8xxx/Kconfig"
osource "/home/blaise/csse4011/zephyr/soc/lowrisc/opentitan/Kconfig"
osource "/home/blaise/csse4011/zephyr/soc/litex/litex_vexriscv/Kconfig"
osource "/home/blaise/csse4011/zephyr/soc/ite/ec/Kconfig"
osource "/home/blaise/csse4011/zephyr/soc/intel/raptor_lake/Kconfig"
osource "/home/blaise/csse4011/zephyr/soc/intel/panther_lake/Kconfig"
osource "/home/blaise/csse4011/zephyr/soc/intel/lakemont/Kconfig"
osource "/home/blaise/csse4011/zephyr/soc/intel/intel_socfpga_std/Kconfig"
osource "/home/blaise/csse4011/zephyr/soc/intel/intel_socfpga/Kconfig"
osource "/home/blaise/csse4011/zephyr/soc/intel/intel_niosv/Kconfig"
osource "/home/blaise/csse4011/zephyr/soc/intel/intel_ish/Kconfig"
osource "/home/blaise/csse4011/zephyr/soc/intel/intel_adsp/Kconfig"
osource "/home/blaise/csse4011/zephyr/soc/intel/elkhart_lake/Kconfig"
osource "/home/blaise/csse4011/zephyr/soc/intel/atom/Kconfig"
osource "/home/blaise/csse4011/zephyr/soc/intel/apollo_lake/Kconfig"
osource "/home/blaise/csse4011/zephyr/soc/intel/alder_lake/Kconfig"
osource "/home/blaise/csse4011/zephyr/soc/infineon/edge/Kconfig"
osource "/home/blaise/csse4011/zephyr/soc/infineon/cat3/Kconfig"
osource "/home/blaise/csse4011/zephyr/soc/infineon/cat1c/Kconfig"
osource "/home/blaise/csse4011/zephyr/soc/infineon/cat1b/Kconfig"
osource "/home/blaise/csse4011/zephyr/soc/infineon/cat1a/Kconfig"
osource "/home/blaise/csse4011/zephyr/soc/gd/gd32/Kconfig"
osource "/home/blaise/csse4011/zephyr/soc/gaisler/leon3/Kconfig"
osource "/home/blaise/csse4011/zephyr/soc/gaisler/gr716a/Kconfig"
osource "/home/blaise/csse4011/zephyr/soc/espressif/Kconfig"
osource "/home/blaise/csse4011/zephyr/soc/ene/kb1200/Kconfig"
osource "/home/blaise/csse4011/zephyr/soc/ene/kb106x/Kconfig"
osource "/home/blaise/csse4011/zephyr/soc/egis/Kconfig"
osource "/home/blaise/csse4011/zephyr/soc/efinix/sapphire/Kconfig"
osource "/home/blaise/csse4011/zephyr/soc/cdns/xtensa_sample_controller/Kconfig"
osource "/home/blaise/csse4011/zephyr/soc/cdns/sample_controller32/Kconfig"
osource "/home/blaise/csse4011/zephyr/soc/cdns/dc233c/Kconfig"
osource "/home/blaise/csse4011/zephyr/soc/brcm/bcmvk/Kconfig"
osource "/home/blaise/csse4011/zephyr/soc/brcm/bcm2712/Kconfig"
osource "/home/blaise/csse4011/zephyr/soc/brcm/bcm2711/Kconfig"
osource "/home/blaise/csse4011/zephyr/soc/bflb/Kconfig"
osource "/home/blaise/csse4011/zephyr/soc/atmel/sam0/Kconfig"
osource "/home/blaise/csse4011/zephyr/soc/atmel/sam/Kconfig"
osource "/home/blaise/csse4011/zephyr/soc/aspeed/Kconfig"
osource "/home/blaise/csse4011/zephyr/soc/arm/Kconfig"
osource "/home/blaise/csse4011/zephyr/soc/arm/beetle/Kconfig"
osource "/home/blaise/csse4011/zephyr/soc/antmicro/myra/Kconfig"
osource "/home/blaise/csse4011/zephyr/soc/andestech/Kconfig"
osource "/home/blaise/csse4011/zephyr/soc/amd/acp_6_0/Kconfig"
osource "/home/blaise/csse4011/zephyr/soc/ambiq/Kconfig"
osource "/home/blaise/csse4011/zephyr/soc/aesc/Kconfig"
osource "/home/blaise/csse4011/zephyr/soc/adi/max32/Kconfig"
```
